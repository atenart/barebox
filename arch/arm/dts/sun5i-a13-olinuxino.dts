/*
 * Copyright 2014 (C) Antoine Tenart
 *
 * Antoine Tenart <antoine.tenart@free-electrons.com>
 *
 * This file is licensed under the terms of the GNU General Public
 * License version 2. This program is licensed "as is" without any
 * warranty of any kind, whether express or implied.
 */

/dts-v1/;
/include/ "sun5i-a13.dtsi"

/ {
	model = "Olimex A13-Olinuxino";
	compatible = "olimex,a13-olinuxino", "allwinner,sun5i-a13";
};

&uart1 { status = "okay"; };
